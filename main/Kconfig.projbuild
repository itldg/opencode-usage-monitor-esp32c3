## main/Kconfig.projbuild
```kconfig
menu "OpenCode Go Usage Display"

    config OPENCODE_WEB_PASSWORD
        string "Web config page password"
        default ""
        help
            网页配置页( http://<设备IP>/ )的登录密码。
            留空则不校验:打开网页即可直接查看/修改配置;
            非空时需输入此密码登录后才能查看/修改。
            OpenCode API Key 与火山 Cookie 均在网页配置页设置(存 NVS)。

    config OPENCODE_WIFI_SSID
        string "WiFi SSID"
        default ""

    config OPENCODE_WIFI_PASSWORD
        string "WiFi Password"
        default ""

    config OPENCODE_REFRESH_MINUTES
        int "Auto refresh interval (minutes)"
        default 30
        help
            自动刷新用量的间隔(分钟)。0 表示不自动刷新,仅手动触摸刷新。

    config OPENCODE_WIFI_RETRY_COUNT
        int "WiFi connect retry count"
        default 10
        help
            WiFi 连接失败后的重试次数(每次间隔 3 秒)。

    config OPENCODE_SOUND_ENABLE
        bool "Enable sound alerts (ES8311 + NS4150B)"
        default y
        help
            用量达到档位/手动刷新/开机时播放 TTS 提示音(ES8311 + NS4150B)。
            关闭后不初始化音频外设,省电。

    config OPENCODE_I2S_MCLK_PIN
        int "I2S MCLK GPIO"
        default 10
    config OPENCODE_I2S_BCLK_PIN
        int "I2S BCLK GPIO"
        default 8
    config OPENCODE_I2S_WS_PIN
        int "I2S WS GPIO"
        default 12
    config OPENCODE_I2S_DOUT_PIN
        int "I2S DOUT GPIO"
        default 11
    config OPENCODE_AUDIO_PA_PIN
        int "NS4150B PA enable GPIO"
        default 13
        help
            ES8311 输出接 NS4150B 功放,此引脚高电平开启功放(低电平关闭)。
            实战派 ESP32-C3 板上接 GPIO13。

endmenu
```
